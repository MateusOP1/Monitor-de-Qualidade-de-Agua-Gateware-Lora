/*
 * Receptor LoRa Gateway WiFi MQTT
 * <smap.iotech@gmail.com>
 * 
 * Codigo para: 
 * Receber variaveis por radio LoRa; 
 * Exibir em display Oled
 * Enviar para servidor MQTT usando WiFi
 */
 
//++++++++++Bibliotecas+++++++++++
#include <WiFiManager.h>
#include <Wire.h>
#include "Arduino.h"
#include "LoRa_E32.h"
#include <WiFi.h>
#include <PubSubClient.h>

#include <Adafruit_GFX.h>
#include <Adafruit_SSD1306.h>

//++++++++++Variáveis+++++++++++

#define MSG_BUFFER_SIZE (50) // Tamanho de buffer
#define TOKEN "RMroOuN61wgPtYUnZKq0" // Token do dispositivo  4JCn62Lnf7FHdUXLdPUF
const char* mqtt_server = "demo.thingsboard.io"; // Endereço do servidor

char msg[MSG_BUFFER_SIZE]; // String msg


//Difinicoes do display Oled
#define OLED_SDA_PIN    21
#define OLED_SCL_PIN    22
#define SCREEN_WIDTH    128 
#define SCREEN_HEIGHT   64  
#define OLED_ADDR       0x3C 
 
//+++++++++Objetos+++++++++++++
LoRa_E32 e32ttl(&Serial);
WiFiClient espClient;
PubSubClient client(espClient);

Adafruit_SSD1306 display(SCREEN_WIDTH, SCREEN_HEIGHT, &Wire);

//+++++++++Funções++++++++++++

//Funcao inicializa comunicacao com display Oled
void display_init(void)
{
    if(!display.begin(SSD1306_SWITCHCAPVCC, OLED_ADDR)) 
    {
        Serial.println("Falha ao inicializar comunicacao com OLED");
        //Loop Infinito ate comunicar
                
    }
    else
    {
        Serial.println("Comunicacao com OLED inicializada com sucesso");
    
        // Limpa display e configura tamanho de fonte e cor 
        display.clearDisplay();
        display.setTextSize(1);
        display.setTextColor(WHITE);
    }
};
void WiFiConnection(){
  
    WiFiManager wm;
  
     bool res;
      // res = wm.autoConnect(); // auto generated AP name from chipid
      res = wm.autoConnect("S_MAP WIFI"); // anonymous ap
    //  res = wm.autoConnect("S_MAPWIFI","admim"); // password protected ap
  
      if(!res) {
          Serial.println("Failed to connect");
//ESP.restart();
      } 
      else {
          //if you get here you have connected to the WiFi    
          Serial.println("connected...yeey :)");
      }
   
}

// Reconecta ao servidor MQTT
void reconnect() {
  // Enquanto não tiver conectado
  while (!client.connected()) {
    Serial.print("Tentando conexão MQTT...");
    // Cria ID randomico
    String clientId = "ESP32Client-";
    clientId += String(random(0xffff), HEX);
    // Tentando conexão MQTT
    if (client.connect(clientId.c_str(), TOKEN, NULL)) {
      Serial.println("Connectado");
    } else {
      Serial.print("Erro de codigo = ");
      Serial.print(client.state());
      Serial.println("Tentanto novamente em 5 segundos");
      delay(5000);
    }
  }
}

// Figura - logo Espk8 
const unsigned char logoespk8 [] PROGMEM = {
  0x00, 0x00, 0x00, 0x00, 0x00, 0x00, 0x00, 0x00, 0x00, 0x00, 0x00, 0x00, 0x00, 0x00, 0x00, 0x00, 
  0x00, 0x00, 0x00, 0x00, 0x00, 0x00, 0x00, 0x00, 0x00, 0x00, 0x00, 0x00, 0x00, 0x00, 0x00, 0x00, 
  0x00, 0x00, 0x01, 0xff, 0xff, 0xff, 0xff, 0xff, 0xff, 0xff, 0xff, 0xff, 0xf0, 0x00, 0x00, 0x00, 
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  0x00, 0x00, 0x00, 0x00, 0x00, 0x00, 0x00, 0x00, 0x00, 0x00, 0x00, 0x00, 0x00, 0x00, 0x00, 0x00
};

void setup()
{
  WiFi.mode(WIFI_STA);
  Serial.begin(9600);
 

  e32ttl.begin(); // Inicia objeto LoRa_E32
  Serial.println("Leitura Inicial");
 
//++++++++++++++++++++++++++++++++
   // Pinos do Display i2C  
    Wire.begin(OLED_SDA_PIN, OLED_SCL_PIN);
    // Inicia display
    display_init();
    display.clearDisplay();
    display.drawBitmap(0, 5, logoespk8 , 128, 64, 1);
    display.setTextColor(WHITE);
    display.setTextSize(1);
    display.setCursor(10,55);
    display.println("Aguarde...");
    display.display();
//++++++++++++++++++++++++++++++++++++++
  WiFiConnection();

  // Caso conecte com sucesso   
  //Serial.println("Conectado :)");
  
    display.clearDisplay();
    display.drawBitmap(0, 5, logoespk8 , 128, 64, 1);
    display.setTextColor(WHITE);
    display.setTextSize(1);
    display.clearDisplay();
    display.setCursor(10,55);
    display.println("Conectado!");
    display.display();
  
  client.setServer(mqtt_server, 1883); // Conecta com o servidor MQTT
 
  delay(1000);
}    

struct Message {
    //char message[8];
    byte phmet[4]; // Variavel de ph
};
struct Message1 {
   // char message1[8];
    byte tempe[4]; // Variavel de temperatura
};
struct Message2 {
   // char message2[8];
    byte salin[4]; // Variavel de salinidade
};
struct Message3 {
   // char message3[8];
    byte sdsus[4]; // Variavel de solidos disolvidos
};

void loop()
{

float inforrecb1;
float inforrecb2;
float inforrecb3;
unsigned int inforrecb4; 
  
  if (!client.connected()) { // Caso não esteja conectado ao servidor MQTT
   reconnect();
 }
  client.loop();
   
  if(e32ttl.available()  > 1){ // Caso rádio LoRa receba dados
   // Serial.print("Rádio LoRa_E32 recebeu dados");
    char type[5];
    ResponseContainer rs = e32ttl.receiveInitialMessage(sizeof(type));
  
    String typeStr = rs.data;
    //Serial.println(typeStr);
    
    if (typeStr=="PHAS"){ // Tipo recebido
      char type[5];
      ResponseStructContainer rsc = e32ttl.receiveMessage(sizeof(Message));
      struct Message message = *(Message*) rsc.data; // Mensagem recebida

      //Serial.println(*(float*)(message.ph)); // Printa a variável
      //Serial.println(message.message);
      inforrecb1 = *(float*)(message.phmet);
      // Prepara, printa e publica payload
      snprintf (msg, MSG_BUFFER_SIZE, "{\"ph\":%.2f}", *(float*)(message.phmet));
     // Serial.print("Publicando payload: ");
      //Serial.println(msg);
      client.publish("v1/devices/me/telemetry", msg);
            

      //rsc.close();
    } 
    if (typeStr == "TEMP"){ // Tipo recebido
      char type[5];
      ResponseStructContainer rsc = e32ttl.receiveMessage(sizeof(Message1));
      struct Message1 message1 = *(Message1*) rsc.data;
      inforrecb2 =  *(float*)(message1.tempe);
      //Serial.println(*(float*)message1.tempe);
      //Serial.println(message1.message1);

      // Prepara, printa e publica payload
      snprintf (msg, MSG_BUFFER_SIZE, "{\"Temperatura\":%.2f}", *(float*)(message1.tempe));
      //Serial.print("Publicando payload: ");
      //Serial.println(msg);
      client.publish("v1/devices/me/telemetry", msg);
    

     // rsc.close();

    }
    if (typeStr == "SALI"){ // Tipo recebido
    char type[5];
      ResponseStructContainer rsc = e32ttl.receiveMessage(sizeof(Message2));
      struct Message2 message2 = *(Message2*) rsc.data;
      inforrecb3 = *(float*)(message2.salin);
      //Serial.println(*(float*)message2.salin);
      //Serial.println(message2.message2);

      // Prepara, printa e publica payload
      snprintf (msg, MSG_BUFFER_SIZE, "{\"Salinidade\":%.2f}", *(float*)(message2.salin));
      //Serial.print("Publicando payload: ");
      //Serial.println(msg);
      client.publish("v1/devices/me/telemetry", msg);
      

      
     // delay(3000);
     // rsc.close();
    }
    if (typeStr == "SDSU"){ // Tipo recebido
     char type[5];
     
      ResponseStructContainer rsc = e32ttl.receiveMessage(sizeof(Message3));
      struct Message3 message3 = *(Message3*) rsc.data;
      inforrecb4 = *(unsigned int*)(message3.sdsus);
      //Serial.println(*(float*)message3.Sdsu);
      //Serial.println(message3.message3);

      // Prepara, printa e publica payload
      snprintf (msg, MSG_BUFFER_SIZE, "{\"Solidos Dissolvidos\":%.d}", (message3.sdsus));
      //Serial.print("Publicando payload: ");
      //Serial.println(msg);
      client.publish("v1/devices/me/telemetry", msg);
    }  


    display.clearDisplay(); 
    display.setTextSize(1);
    display.setCursor(20, 0);  // column row
    display.print("Monitor S_MAP");
    
  
    display.setCursor(3, 20);  // column row
    display.print("pH:");
    display.setCursor(60, 20);
    display.print(inforrecb1);
  
    display.setCursor(3, 30);
    display.print("Temp:");
    display.setCursor(60, 30);
    display.print(inforrecb2);

    display.setCursor(3, 40);
    display.print("CE:");
    display.setCursor(60, 40);
    display.print(inforrecb3);
  
    display.setCursor(3, 50);
    display.print("SDT:");

    display.setCursor(60, 50);
    display.print(inforrecb4);
    display.display();
      
   // delay(3000);
    
  }  
  delay(1000);
}
